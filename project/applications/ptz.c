/*
 * PTZ 云台电机驱动
 * JC 系列闭环驱动器, Modbus RTU @ USART3 (PD8=TX, PD9=RX, 115200)
 * 机械限位 [199.50°, 225.50°], SetAbsAngle 内部强制钳制
 */
#include "ptz.h"
#include <rtdevice.h>
#include <stdlib.h>

#define DBG_TAG "ptz"
#define DBG_LVL DBG_INFO
#include <rtdbg.h>

#define PTZ_DEV_NAME   "uart3"

/* Modbus CRC16 查表法: 高位字节表 */
static const uint8_t aucCRCHi[256] = {
0x00, 0xC1, 0x81, 0x40, 0x01, 0xC0, 0x80, 0x41, 0x01, 0xC0, 0x80, 0x41, 0x00, 0xC1, 0x81,
0x40, 0x01, 0xC0, 0x80, 0x41, 0x00, 0xC1, 0x81, 0x40, 0x00, 0xC1, 0x81, 0x40, 0x01, 0xC0,
0x80, 0x41, 0x01, 0xC0, 0x80, 0x41, 0x00, 0xC1, 0x81, 0x40, 0x00, 0xC1, 0x81, 0x40, 0x01,
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0x00, 0xC1, 0x81, 0x40, 0x01, 0xC0, 0x80, 0x41, 0x01, 0xC0, 0x80, 0x41, 0x00, 0xC1, 0x81,
0x40
};

/* Modbus CRC16 查表法: 低位字节表 */
static const uint8_t aucCRCLo[256] = {
0x00, 0xC0, 0xC1, 0x01, 0xC3, 0x03, 0x02, 0xC2, 0xC6, 0x06, 0x07, 0xC7, 0x05, 0xC5, 0xC4,
0x04, 0xCC, 0x0C, 0x0D, 0xCD, 0x0F, 0xCF, 0xCE, 0x0E, 0x0A, 0xCA, 0xCB, 0x0B, 0xC9, 0x09,
0x08, 0xC8, 0xD8, 0x18, 0x19, 0xD9, 0x1B, 0xDB, 0xDA, 0x1A, 0x1E, 0xDE, 0xDF, 0x1F, 0xDD,
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0x44, 0x84, 0x85, 0x45, 0x87, 0x47, 0x46, 0x86, 0x82, 0x42, 0x43, 0x83, 0x41, 0x81, 0x80,
0x40
};

/* Modbus CRC16, 返回值低字节为 CRC 低字节 (发送时低字节在前) */
static uint16_t PTZ_CRC16(const uint8_t *msg, uint16_t len)
{
    uint8_t crcHi = 0xFF;
    uint8_t crcLo = 0xFF;
    uint8_t idx;
    while (len--)
    {
        idx   = crcLo ^ *msg++;
        crcLo = crcHi ^ aucCRCHi[idx];
        crcHi = aucCRCLo[idx];
    }
    return ((uint16_t)crcHi << 8) | crcLo;
}

static rt_device_t ptz_dev = RT_NULL;

/* 发送一帧 (阻塞写), 帧间隔 ≥3.5 字符静默防止从站误判 */
static void PTZ_SendBuf(const uint8_t *buf, uint16_t len)
{
    if (ptz_dev == RT_NULL) return;
    rt_device_write(ptz_dev, 0, buf, len);
    rt_thread_mdelay(1);
}

/* 进入闭环: 01 06 00 A2 00 01 E9 E8 (CRC 固定) */
void PTZ_CloseLoop(void)
{
    static const uint8_t frame[8] = {
        PTZ_MOTOR_ID, 0x06, 0x00, 0xA2, 0x00, 0x01, 0xE9, 0xE8
    };
    PTZ_SendBuf(frame, 8);
}

/* 限位钳制: 超出 [MIN, MAX] 强制压到边界, 防止机械损坏 */
int32_t PTZ_ClampAngle(int32_t ang)
{
    if (ang < PTZ_ANGLE_MIN) return PTZ_ANGLE_MIN;
    if (ang > PTZ_ANGLE_MAX) return PTZ_ANGLE_MAX;
    return ang;
}

/* 绝对位置: 01 10 00 23 00 02 04 [ang 4B] [CRC_L][CRC_H], ang 单位 0.01°, 自动限位 */
void PTZ_SetAbsAngle(int32_t ang)
{
    uint8_t buf[13];
    uint16_t crc;
    ang = PTZ_ClampAngle(ang);
    buf[0]  = PTZ_MOTOR_ID;
    buf[1]  = 0x10;
    buf[2]  = 0x00;
    buf[3]  = 0x23;
    buf[4]  = 0x00;
    buf[5]  = 0x02;
    buf[6]  = 0x04;
    buf[7]  = (uint8_t)(ang >> 24);
    buf[8]  = (uint8_t)(ang >> 16);
    buf[9]  = (uint8_t)(ang >> 8);
    buf[10] = (uint8_t)(ang);
    crc = PTZ_CRC16(buf, 11);
    buf[11] = (uint8_t)(crc);        /* CRC 低字节在前 */
    buf[12] = (uint8_t)(crc >> 8);
    PTZ_SendBuf(buf, 13);
}

/* 实时位置寄存器 0x0008 (放大100倍=0.01°, JC 协议手册 4.4 节) */
#define PTZ_REG_ANGLE        0x0008

/* 读 2 寄存器回复帧长: [01][03][04][d3 d2 d1 d0][crcL][crcH] = 9 字节 */
#define PTZ_RX_FRAME_LEN     9

int PTZ_Init(void)
{
    ptz_dev = rt_device_find(PTZ_DEV_NAME);
    if (ptz_dev == RT_NULL)
    {
        LOG_E("find %s failed", PTZ_DEV_NAME);
        return -RT_ERROR;
    }
    if (rt_device_open(ptz_dev, RT_DEVICE_OFLAG_RDWR | RT_DEVICE_FLAG_INT_RX) != RT_EOK)
    {
        LOG_E("open %s failed", PTZ_DEV_NAME);
        ptz_dev = RT_NULL;
        return -RT_ERROR;
    }
    LOG_I("ptz ready on %s", PTZ_DEV_NAME);
    return RT_EOK;
}

/* 读取当前角度 (单位 0.01°): 发读请求后轮询收 9 字节, CRC 校验, 超时 100ms */
uint8_t PTZ_ReadAngle(int32_t *angle)
{
    uint8_t  req[8];
    uint8_t  rxBuf[PTZ_RX_FRAME_LEN];
    uint16_t crc;
    int rx_len = 0;
    int retry;
    rt_size_t n;

    if (ptz_dev == RT_NULL) return 0;

    /* 清接收缓冲残留 */
    while (rt_device_read(ptz_dev, 0, &rxBuf[0], 1) == 1) {}

    req[0] = PTZ_MOTOR_ID;
    req[1] = 0x03;
    req[2] = (uint8_t)(PTZ_REG_ANGLE >> 8);
    req[3] = (uint8_t)(PTZ_REG_ANGLE);
    req[4] = 0x00;
    req[5] = 0x02;
    crc = PTZ_CRC16(req, 6);
    req[6] = (uint8_t)(crc);
    req[7] = (uint8_t)(crc >> 8);
    rt_device_write(ptz_dev, 0, req, 8);

    for (retry = 0; retry < 100 && rx_len < PTZ_RX_FRAME_LEN; retry++)
    {
        while ((n = rt_device_read(ptz_dev, 0, &rxBuf[rx_len],
                                   PTZ_RX_FRAME_LEN - rx_len)) > 0)
        {
            rx_len += (int)n;
            if (rx_len >= PTZ_RX_FRAME_LEN) break;
        }
        if (rx_len < PTZ_RX_FRAME_LEN) rt_thread_mdelay(1);
    }
    if (rx_len < PTZ_RX_FRAME_LEN) return 0;

    crc = PTZ_CRC16(rxBuf, 7);
    if (rxBuf[0] == PTZ_MOTOR_ID && rxBuf[1] == 0x03 && rxBuf[2] == 0x04
        && rxBuf[7] == (uint8_t)(crc) && rxBuf[8] == (uint8_t)(crc >> 8))
    {
        *angle = ((int32_t)rxBuf[3] << 24) | ((int32_t)rxBuf[4] << 16)
               | ((int32_t)rxBuf[5] << 8)  | (int32_t)rxBuf[6];
        return 1;
    }
    return 0;
}

/* ---- msh 测试命令 ---- */
static void ptz_ang_cmd(int argc, char **argv)
{
    if (argc >= 2)
    {
        int32_t ang = PTZ_DEG(atof(argv[1]));
        PTZ_SetAbsAngle(ang);
        rt_kprintf("ptz -> %d.%02d deg (clamped %d..%d)\n",
                   (int)(ang / 100), (int)(ang % 100) < 0 ? -(int)(ang % 100) : (int)(ang % 100),
                   PTZ_ANGLE_MIN, PTZ_ANGLE_MAX);
    }
    else
    {
        rt_kprintf("usage: ptz_ang_cmd <deg> (range 199.50 ~ 225.50)\n");
    }
}
MSH_CMD_EXPORT(ptz_ang_cmd, set PTZ absolute angle in deg);

static void ptz_mid_cmd(int argc, char **argv)
{
    PTZ_SetAbsAngle(PTZ_ANGLE_MID);
    rt_kprintf("ptz -> mid %d.%02d deg\n", PTZ_ANGLE_MID / 100, PTZ_ANGLE_MID % 100);
}
MSH_CMD_EXPORT(ptz_mid_cmd, PTZ back to mid angle);

static void ptz_read_cmd(int argc, char **argv)
{
    int32_t ang;
    if (PTZ_ReadAngle(&ang))
        rt_kprintf("angle=%d.%02d deg\n", (int)(ang / 100), (int)(ang % 100));
    else
        rt_kprintf("read failed (timeout/crc)\n");
}
MSH_CMD_EXPORT(ptz_read_cmd, read PTZ current angle);
